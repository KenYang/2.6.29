## 2.6.29/arch/arm/mach-socle/Kconfig
```kconfig
if ARCH_SOCLE

comment "Socle Platform Implementations"

choice
        prompt "Platform Type"
        default CONFIG_ARCH_LDK3V21

config ARCH_LDK3V21
	bool "Leopard 3 V2.1"
	select SOCLE_DMA_A2A
	select MMC_SOCLE_SDMMC_AUTO_SWAP
	 	  	  
config ARCH_LDK5
	bool "Leopard 5"
	
config ARCH_CDK
	bool "Cheetah C1"  
	select SOCLE_DMA_HDMA
	select SOCLE_DMA_PANTHER7_HDMA

config ARCH_SCDK
        bool "SCDK"
        select SOCLE_DMA_HDMA
        select SOCLE_DMA_PANTHER7_HDMA
	
config ARCH_PDK_PC9002
	bool "PDK-PC9002"
	select SOCLE_DMA_HDMA
        select SOCLE_DMA_PANTHER7_HDMA

config ARCH_PDK_PC9220
	bool "PDK-PC9220"
	select SOCLE_DMA_PANTHER7_HDMA

config ARCH_PDK_PC9223
	bool "PDK-PC9223"
	select SOCLE_DMA_PANTHER7_HDMA


config ARCH_P7DK
        bool "Panther 7"
        select SOCLE_DMA_PANTHER7_HDMA

config ARCH_PDK_PC7210
	bool "PDK-PC7210 / PDK-PC7230"
	select SOCLE_DMA_PANTHER7_HDMA

config ARCH_MSMV
        bool "MSMV"
        select SOCLE_DMA_PANTHER7_HDMA

config ARCH_MDK_3D
	bool "MDK-3D"
	select SOCLE_DMA_PANTHER7_HDMA

config ARCH_MDK_FHD
	bool "MDK-FHD"
	select SOCLE_DMA_PL080

endchoice

config SOCLE_DMA_A2A
	bool

config SOCLE_DMA_HDMA
	bool

config SOCLE_DMA_PANTHER7_HDMA
	bool 

config SOCLE_DMA_PL080
	bool 
	
config SQ_GDR
	bool "SQ_GDR"
	
endif
```

## sound/arm/snd-socle/Kconfig
```kconfig
config SND_SOCLE
	tristate "Socle Soundcard driver"
	depends on SND 
	help
	  Say y here to include support for Soundcard interface of Socle.

	  To compile this driver as a module, choose M here: the module
	  will be called snd-socle

choice
	depends on SND_SOCLE
	prompt "Socle soundcard type"
	default SND_SOCLE_NO_DMA

config SND_SOCLE_NO_DMA
	bool "No dma"
	help
	  Say y here to include support for Soundcard interface of Socle.

	  To compile this driver as a module, choose M here: the module
	  will be called snd-socle

config SND_SOCLE_HW_DMA
	bool "With hardware dma"
	help
	  Say y here to include support for Soundcard interface of Socle.

	  To compile this driver as a module, choose M here: the module
	  will be called snd-socle-hwdma

endchoice
```

## sound/soc/socle/Kconfig
```kconfig
config SND_SOC_SOCLE
        tristate "Socle Soundcard driver"
	depends on SND
	help
	  Say Y or M if you want to add support for codecs attached to
	  the SOCLE AC97,or I2S interface. You will also need
	  to select the audio interfaces to support below.
choice
	depends on SND_SOC_SOCLE
	prompt "Socle soundcard type"
	default SND_SOC_SOCLE_NO_DMA

config SND_SOC_SOCLE_NO_DMA
	bool "Without hardware dma"

config SND_SOC_SOCLE_HW_DMA
	bool "With hardware dma"

endchoice

config SND_SOC_SOCLE_AC97
	tristate "AC97 BUS"
	select AC97_BUS
	select SND_SOC_AC97_BUS

choice
	depends on SND_SOC_SOCLE
	prompt "Socle soundcard"
	default SND_SOC_SOCLE_UDA1342TS

config SND_SOC_SOCLE_UDA1342TS
	depends on SND_SOC_UDA1342TS
	tristate "SOCLE_UDA1342TS"

config SND_SOC_SOCLE_MS6335
        depends on SND_SOC_MS6335
        tristate "SOCLE_MS6335"

config SND_SOC_SOCLE_WM8961
        depends on SND_SOC_WM8961
        tristate "SOCLE_WM8961"

config SND_SOC_SOCLE_WM9714_I2S
	depends on SND_SOC_WM9714
	tristate "SOCLE_WM9714_I2S"

config SND_SOC_SOCLE_WM9714_AC97
	tristate "SOCLE_WM9714_AC97"
	depends on SND_SOC_WM9714
	select SND_SOC_AC97_CODEC
	help
	  Say Y if you want to add support for SoC audio on Socle
	  with the WM9714.

config SND_SOC_SOCLE_ALC658_AC97
        tristate "SOCLE_ALC658_AC97"
        depends on SND_SOC_ALC658
        select SND_SOC_AC97_CODEC
        help
          Say Y if you want to add support for SoC audio on Socle
          with the WM9714.

endchoice

config AC97_COMPACT_MODE
	bool "AC97 Audio with Compact Mode"
	depends on SND_SOC_SOCLE_WM9714_AC97 && SND_SOC_SOCLE_HW_DMA 
	help
	  Say y if you want to use Compact Mode for AC97 Controller.
```
